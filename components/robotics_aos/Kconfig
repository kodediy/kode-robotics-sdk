## components/robotics_aos/Kconfig
```kconfig
menu "Robotics module SDK"

    config ROBOTICS_AO_PRIORITY
        int "Priority of the module's owner (0: KODE_PRIO_USER_HIGH)"
        range 0 24
        default 0
        help
            The QP/C priority of the Active Object that owns the Robotics
            module, which is also its task's FreeRTOS priority. 0 takes
            kode-sdk's KODE_PRIO_USER_HIGH; robotics_ao.c says why. Two Active
            Objects at one level stop the board when the second starts, so
            an app whose own Active Object needs KODE_PRIO_USER_HIGH moves
            this one to a level nothing in its image holds.

endmenu
```

## components/robotics_sys/Kconfig
```kconfig
menu "Robotics module SDK, extended layer"

    config ROBOTICS_SIG_OFFSET
        int "Where the Robotics signals start above MAX_SIG"
        range 1000 60000
        default 1100
        help
            robotics_sys.h's signals (the answers and the news) are posted,
            never published, and live in a range of their own: from
            MAX_SIG + this offset, for as many as the header lists. An app's
            own signals are MAX_SIG to MAX_SIG + 999. The Mesh SDK takes 1000,
            this one 1100, the Camera SDK 1200 and the F*CK SDK 1300, so an app
            that uses two of them has no signal twice; change it only when
            another library's range is in the way.

endmenu
```
